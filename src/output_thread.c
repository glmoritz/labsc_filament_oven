/*
 * Copyright (c) 2026 Guilherme Luiz Moritz
 * SPDX-License-Identifier: Apache-2.0
 *
 * Output thread (architecture, "Output Thread"). Runs at 120 Hz (8.333 ms). It
 * is the FAST safety actuator: every cycle it gives every fault detector a
 * <= 8.33 ms path to de-energization, and it stops the SSR-enable keep-alive
 * pulse within <= 2 control periods of PID staleness.
 *
 * The keep-alive pulse is generated by an in-thread GPIO edge every cycle. It
 * is NEVER produced by hardware PWM/LEDC/RMT: a hung CPU keeps hardware PWM
 * running forever and would silently defeat the missing-pulse detector
 * (architecture, "HARD DESIGN RULE").
 *
 * Two-state safety latch:
 *   OUT_RUN  -> pulses allowed when ARMED, PID fresh, fault word clear.
 *   OUT_SAFE -> forced off, latched, never pulses again until reboot.
 */

#include "shared.h"
#include "oven_threads.h"
#include "oven_state.h"

#include <zephyr/kernel.h>
#include <zephyr/drivers/gpio.h>
#include <zephyr/logging/log.h>

LOG_MODULE_REGISTER(output, LOG_LEVEL_INF);

#define OUTPUT_PULSE_WIDTH_US   (100U)

enum output_state {
	OUT_RUN  = 0,
	OUT_SAFE = 1,
};

static const struct gpio_dt_spec s_keepalive =
	GPIO_DT_SPEC_GET(DT_ALIAS(keepalive_out), gpios);

/* One software keep-alive edge: assert briefly, then release. */
static void emit_keepalive_pulse(void)
{
	(void)gpio_pin_set_dt(&s_keepalive, 1);
	k_busy_wait(OUTPUT_PULSE_WIDTH_US);
	(void)gpio_pin_set_dt(&s_keepalive, 0);
}

static void force_keepalive_off(void)
{
	(void)gpio_pin_set_dt(&s_keepalive, 0);
}

static void output_thread_entry(void *p1, void *p2, void *p3)
{
	enum output_state state = OUT_RUN;
	uint32_t last_pid_seq = 0U;
	uint32_t cycles_since_pid = 0U;
	bool pid_seen = false;

	ARG_UNUSED(p1);
	ARG_UNUSED(p2);
	ARG_UNUSED(p3);

	__ASSERT(k_thread_priority_get(k_current_get()) == OVEN_OUTPUT_PRIO,
		 "Output thread priority mismatch");

	while (atomic_get(&g_init_done) == 0) {
		k_sleep(K_MSEC(1));
	}

	/* Own the SSR-enable pin: configured inactive before the first pulse. */
	(void)gpio_pin_configure_dt(&s_keepalive, GPIO_OUTPUT_INACTIVE);
	last_pid_seq = (uint32_t)atomic_get(&g_pid_seq);

	for (;;) {
		uint32_t pid_seq;
		bool pulse_enabled;

		/* 1. Fault word: any bit set latches this thread SAFE. */
		if (fault_word_get() != 0U) {
			state = OUT_SAFE;
		}

		/* 2. PID freshness over a <= 1 s window (<= 2 control periods). */
		pid_seq = (uint32_t)atomic_get(&g_pid_seq);
		if (seq_advanced(pid_seq, last_pid_seq)) {
			last_pid_seq = pid_seq;
			cycles_since_pid = 0U;
			pid_seen = true;
		} else if (pid_seen) {
			cycles_since_pid++;
			if (cycles_since_pid > OVEN_PID_STALE_LIMIT_CYCLES) {
				fault_raise((uint32_t)OVEN_FAULT_PID_STALE);
				state = OUT_SAFE;
			}
		} else {
			/* PID has not produced its first cycle yet; wait. */
		}

		/*
		 * 3-5. Decide the SSR-enable keep-alive. Pulses only when the
		 * safety latch is intact, the operator has armed, the fault word
		 * is clear, and PID data is fresh. The actual burst-fire power
		 * decision (heater_power) is applied by the SSR downstream; in
		 * this bootstrap heater_power is held at 0, so the pulse gates
		 * SSR enable only.
		 */
		pulse_enabled = (state == OUT_RUN) &&
				(oven_state_get() == OVEN_STATE_ARMED) &&
				(fault_word_get() == 0U) &&
				(cycles_since_pid <= OVEN_PID_STALE_LIMIT_CYCLES);

		if (pulse_enabled) {
			emit_keepalive_pulse();
		} else {
			force_keepalive_off();
		}

		/* 6. Advance the liveness counter and pace the loop. */
		(void)atomic_inc(&g_output_seq);
		k_sleep(K_USEC(OVEN_OUTPUT_PERIOD_US));
	}
}

K_THREAD_DEFINE(output_tid, OVEN_OUTPUT_STACK_SIZE, output_thread_entry,
		NULL, NULL, NULL, OVEN_OUTPUT_PRIO, 0, 0);

bool output_devices_ready(void)
{
	return gpio_is_ready_dt(&s_keepalive);
}
